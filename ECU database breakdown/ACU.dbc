VERSION ""

NS_ :

BS_:

BU_: VEHICLE_CONTROL_UNIT ACCUMULATOR_CONTROL_UNIT MOTOR_CONTROLLER EMUS_BMS U2C
VAL_TABLE_ SWITCH_TOGGLE 1 "TRUE/ON" 0 "FALSE/OFF" ;
VAL_TABLE_ MC_BUS_STATE 1 "CHARGED" 0 "DISCHARGED" ;
VAL_TABLE_ SET_INVERTER_DISCHARGE 1 "ENABLED" 0 "DISABLED" ;
VAL_TABLE_ SET_INVERTER_ENABLE 1 "ENABLED" 0 "DISABLED" ;
VAL_TABLE_ SET_MC_DIRECTION 1 "FORWARD" 0 "REVERSE" ;
VAL_TABLE_ DriveState 0 "DriveDisabled" ;

BO_ 3221225472 VECTOR__INDEPENDENT_SIG_MSG: 0 Vector__XXX
 SG_ New_Signal_655 : 0|8@1+ (1,0) [0|0] "" Vector__XXX

BO_ 2 CAN_ACU_TO_VCU_ID: 8 MOTOR_CONTROLLER
 SG_ HTL_CH_ID_ACU_TO_VCU_HEARTBEAT : 0|8@1+ (1,0) [0|255] ""  VEHICLE_CONTROL_UNIT

BO_TX_BU_ 2 : ACCUMULATOR_CONTROL_UNIT,MOTOR_CONTROLLER;

CM_ BU_ VEHICLE_CONTROL_UNIT "The system vehicle control unit";
CM_ BU_ MOTOR_CONTROLLER "The Cascadia Motion inverter";
CM_ BU_ EMUS_BMS "BMS Master";
CM_ BU_ U2C "Delphi DC/DC Converter";
CM_ BO_ 3221225472 "This is a message for not used signals, created by Vector CANdb++ DBC OLE DB Provider.";
BA_DEF_  "BusType" STRING ;
BA_DEF_DEF_  "BusType" "CAN";
