VERSION ""

NS_ :

BS_:

BU_: ENERGY_METER INERTIAL_MEASUREMENT_UNIT SENSOR_CONTROL_UNIT VEHICLE_CONTROL_UNIT ACCUMULATOR_CONTROL_UNIT MOTOR_CONTROLLER EMUS_BMS U2C

VAL_TABLE_ SWITCH_TOGGLE 1 "TRUE/ON" 0 "FALSE/OFF" ;
VAL_TABLE_ MC_BUS_STATE 1 "CHARGED" 0 "DISCHARGED" ;
VAL_TABLE_ SET_INVERTER_DISCHARGE 1 "ENABLED" 0 "DISABLED" ;
VAL_TABLE_ SET_INVERTER_ENABLE 1 "ENABLED" 0 "DISABLED" ;
VAL_TABLE_ SET_MC_DIRECTION 1 "FORWARD" 0 "REVERSE" ;
VAL_TABLE_ DriveState 0 "DriveDisabled" ;

BO_ 3221225472 VECTOR__INDEPENDENT_SIG_MSG: 0 Vector__XXX
 SG_ New_Signal_655 : 0|8@1+ (1,0) [0|0] "" Vector__XXX

BO_ 21 CAN_ACU_TO_VCU_ID: 8 ACCUMULATOR_CONTROL_UNIT
 SG_ HTL_CH_ID_ACU_TO_VCU_HEARTBEAT : 0|8@1+ (1,0) [0|255] ""  VEHICLE_CONTROL_UNIT

CM_ BO_ 3221225472 "This is a message for not used signals, created by Vector CANdb++ DBC OLE DB Provider.";

BA_DEF_  "BusType" STRING ;

BA_DEF_DEF_  "BusType" "CAN";
